## boards/shields/nice_view_custom/Kconfig.defconfig
```kconfig
# SPDX-License-Identifier: MIT

if SHIELD_NICE_VIEW_CUSTOM

config LS0XX_VCOM_THREAD_PRIO
    default 11

config LV_Z_VDB_SIZE
    default 100

config LV_DPI_DEF
    default 161

config LV_Z_BITS_PER_PIXEL
    default 1

choice LV_COLOR_DEPTH
    default LV_COLOR_DEPTH_1
endchoice

choice ZMK_DISPLAY_WORK_QUEUE
    default ZMK_DISPLAY_WORK_QUEUE_DEDICATED
endchoice

choice ZMK_DISPLAY_STATUS_SCREEN
    default ZMK_DISPLAY_STATUS_SCREEN_CUSTOM
endchoice

config LV_Z_MEM_POOL_SIZE
    default 8192 if ZMK_DISPLAY_STATUS_SCREEN_CUSTOM

config ZMK_DISPLAY_STATUS_SCREEN_CUSTOM
    imply NICE_VIEW_CUSTOM_WIDGET

config NICE_VIEW_CUSTOM_WIDGET
    bool "nice!view custom status widget"
    select LV_FONT_MONTSERRAT_16
    select LV_FONT_MONTSERRAT_12
    select LV_FONT_UNSCII_8
    select LV_USE_IMAGE
    select LV_USE_CANVAS

config NICE_VIEW_CUSTOM_INVERTED
    bool "Invert colors (white on black)"

config NICE_VIEW_CUSTOM_ART
    string "Path to a custom art .c file (absolute, or relative to the zmk-config folder)"
    default ""
    help
      C file defining `const lv_image_dsc_t nice_view_custom_art`, as generated by
      tools/png2lvgl.py. Leave empty to use the built-in placeholder.

config NICE_VIEW_CUSTOM_PERIPHERAL_LABEL
    string "Text shown in the bottom band of the peripheral half (empty = nothing)"
    default ""

endif # SHIELD_NICE_VIEW_CUSTOM
```
